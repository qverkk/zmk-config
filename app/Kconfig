## app/Kconfig
```kconfig
# Kconfig for the battery-report behavior module

config ZMK_BATTERY_REPORT_BEHAVIOR
    bool "Battery Report Behavior"
    depends on ZMK_BATTERY_REPORTING && ZMK_SPLIT_ROLE_CENTRAL
    help
      Enables a behavior that, when triggered, types the battery
      percentage of both keyboard halves as a text string
      (e.g. "L:87% R:92%").
```

## dts/bindings/behaviors/zmk,bat-report.yaml
```yaml
description: |
  ZMK Battery Report behavior - types the battery percentage of both
  the central (left) and peripheral (right) keyboard halves as text.

  Example output when triggered:  L:87% R:92%

compatible: "zmk,bat-report"

include: zero_param.yaml
```
